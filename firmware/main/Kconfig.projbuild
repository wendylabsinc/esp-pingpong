## firmware/main/Kconfig.projbuild
```kconfig
menu "Tap locator"

    config TAPLOC_SAMPLE_RATE
        int "Microphone sample rate (Hz)"
        default 16000
        help
            One sample is 1/rate seconds of sound travel: 2.1 cm at 16 kHz.
            All boards must use the same rate.

    config TAPLOC_TRIGGER_RATIO
        int "Trigger when a sample exceeds this many times the background level"
        default 12
        help
            Lower hears quieter taps and more false ones.

    config TAPLOC_TRIGGER_MIN
        int "Smallest sample magnitude that can trigger (of 32768)"
        default 200
        help
            Keeps a silent room, where the background level is near zero,
            from triggering on nothing.

    config TAPLOC_BUZZER_GPIO
        int "GPIO the piezo buzzer is on (-1: none, this board only listens)"
        default 1
        range -1 48
        help
            GPIO 1 is pad D0 on the XIAO. Wire a piezo disc or a passive piezo
            buzzer between this pin and GND. A magnetic buzzer or a speaker
            draws more than a pin can give and needs a transistor.

    config TAPLOC_SWEEP_F0
        int "Sweep start (Hz)"
        default 2000

    config TAPLOC_SWEEP_F1
        int "Sweep end (Hz)"
        default 6000
        help
            Must stay under half the sample rate. A wider sweep times more
            sharply; a piezo is loudest between about 2 and 5 kHz. All boards
            must use the same sweep.

    config TAPLOC_SWEEP_MS
        int "Sweep length (ms)"
        default 50
        range 20 64
        help
            A longer sweep is heard further away: doubling it is worth about
            40% more distance.

    config TAPLOC_SWEEP_PERIOD_MS
        int "Average time between this board's sweeps (ms)"
        default 3000
        range 500 60000
        help
            Each gap is random, 25% either side of this. More sweeps track the
            clocks more closely; fewer are quieter and leave more silence for
            hearing taps.

    config TAPLOC_SWEEP_DETECT_DB
        int "A sweep must stand this far above the background (dB)"
        default 13
        range 8 30
        help
            Lower hears sweeps from further away and reports more false ones,
            which the box discards.

    config TAPLOC_BEACON_MS
        int "Time between ESP-NOW timing beacons (ms); 0 switches the radio link off"
        default 250
        range 0 1000
        help
            Boards that hear the same beacon hear it at the same instant, which
            relates their clocks without buzzers. The same radio link carries
            reports to a neighbour that can reach the box. It keeps the Wi-Fi
            radio awake, which costs tens of milliamps. With 0 the boards rely
            on sweeps or calibration taps and the radio sleeps between reports.
            All boards must be on the same channel: see the next setting.

    config TAPLOC_RADIO_CHANNEL
        int "Channel for the ESP-NOW link (0: stay on Wi-Fi and use its channel)"
        default 1
        range 0 13
        depends on TAPLOC_BEACON_MS > 0
        help
            With a channel set, the board leaves its Wi-Fi network and keeps
            its radio on this channel, so every board is certain to be on the
            same one wherever it is. Reports then reach the box through a
            neighbouring board that is on USB or Wendy Net, and the board can
            only be deployed to over USB. All boards must use the same channel.

    config TAPLOC_REPORT_MS
        int "Time between reports to the box (ms)"
        default 5000
        range 500 60000
        help
            The radio sleeps between reports. Taps are still sent at once.

    config TAPLOC_PORT
        int "UDP port the box listens on"
        default 47800

    config TAPLOC_BOX_HOST
        string "Box IPv4 address (empty: find it by broadcast)"
        default ""
        help
            Set this on networks that do not carry broadcast traffic.

endmenu
```

## range/main/Kconfig.projbuild
```kconfig
menu "Ping-pong range"

    config PP_BUZZER_GPIO
        int "GPIO the piezo buzzer is on"
        default 1
        range 0 48
        help
            GPIO 1 is pad D0 on the XIAO ESP32S3. The piezo goes between this
            pin and GND.

    config PP_SELF_MM
        int "Distance from the buzzer to the microphone on a board (mm)"
        default 40
        range 0 500
        help
            Each board hears its own sweep a few centimetres away, and the
            result is corrected for it. An error here adds straight onto
            every distance. Measure it, and keep it the same on both boards.

    config PP_TEMP_C10
        int "Air temperature in tenths of a degree C"
        default 200
        range -200 500
        help
            Speed of sound is 331.3 + 0.606 * T m/s: 0.17% per degree.

    config PP_SWEEP_F0
        int "Sweep start (Hz)"
        default 2000

    config PP_SWEEP_F1
        int "Sweep end (Hz)"
        default 6000

    config PP_SWEEP_MS
        int "Sweep length (ms)"
        default 64
        range 20 64

    config PP_DETECT_DB
        int "A sweep must stand this far above the background (dB)"
        default 10
        range 8 30

    config PP_ROUND_MS
        int "Time between ping-pong rounds (ms)"
        default 1500
        range 800 60000

    config PP_REPLY_MS
        int "How long the replying board waits before its sweep (ms)"
        default 500
        range 400 2000
        help
            The detector is deaf for about a third of a second after a sweep,
            so this must stay above 400. A shorter wait leaves less time for
            the two clocks to drift apart between the sweeps.

    config PP_CHANNEL
        int "ESP-NOW channel (both boards must match)"
        default 1
        range 1 13
        help
            The boards leave their Wi-Fi network and sit on this channel.

    config PP_GROUP
        int "Group id: boards only talk to boards with the same id"
        default 1
        range 0 255

    config PP_BUZZER_GPIO2
        int "Second buzzer GPIO for bridge drive (-1: none)"
        default 2
        range -1 48
        help
            With a pin here the buzzer is driven from both pins in opposite
            phase, which doubles the voltage across a piezo: about 6 dB louder.
            GPIO 2 is pad D1 on the XIAO ESP32S3. Wire the piezo between D0
            and D1, NOT to GND. Set -1 to go back to D0 and GND.

    config PP_SELFTEST_S
        int "Buzzer test at boot: seconds of sweeps before ranging starts (0: off)"
        default 30
        range 0 120
        help
            The board plays back-to-back sweeps so the buzzer can be heard and
            its wires checked. Ranging starts when it ends.

endmenu
```

## wendy-lite-espnow/leaf/wendy_espnow/Kconfig
```kconfig
menu "Wendy ESP-NOW link"
    config WENDY_ESPNOW
        bool "ESP-NOW link: time-sync beacons and a carrier for the mesh leaf"
        default n
        depends on WENDY_WIFI_ENABLED
        help
            Listens for signed soundsync beacons (SSB1) from an Anchor dongle
            and logs their hardware receive time on the esp_timer clock, the
            reference-broadcast time sync of the acoustic nodes. Beacons stay
            plain ESP-NOW broadcasts so their receive stamps are untouched.

            Also carries the signed mesh leaf: a TCP listener on 127.0.0.1
            whose bytes travel over a reliable ESP-NOW stream to the Anchor,
            which relays them to its WendyOS agent's leaf listener. The leaf's
            mutually authenticated TLS runs end to end over it. Hackathon
            feature.

    config WENDY_ESPNOW_PROXY_PORT
        int "Local TCP port of the mesh carrier proxy"
        depends on WENDY_ESPNOW
        default 43124

    config WENDY_ESPNOW_LOG_BEACONS
        bool "Log every beacon's receive time (B lines)"
        depends on WENDY_ESPNOW
        default y

    config WENDY_ESPNOW_LOG_AP_BEACONS
        bool "Also log the receive time of the associated AP's beacons (A lines)"
        depends on WENDY_ESPNOW
        default n
        help
            For measuring time sync against any other receiver on the channel,
            without a second node. Turns promiscuous receive of management
            frames on.
endmenu
```

## wendy-lite-espnow/wendy_espnow/Kconfig
```kconfig
menu "Wendy ESP-NOW link"
    config WENDY_ESPNOW
        bool "ESP-NOW link: time-sync beacons and a Wendy Net carrier stream"
        default n
        depends on WENDY_WIFI_ENABLED
        help
            Listens for signed soundsync beacons (SSB1) from an Anchor dongle
            and logs their hardware receive time on the esp_timer clock, the
            reference-broadcast time sync of the acoustic nodes. Beacons stay
            plain ESP-NOW broadcasts so their receive stamps are untouched.

            Also offers Wendy Net a carrier: a reliable byte stream to the
            Anchor over ESP-NOW unicast frames. Wendy Net runs its usual
            mutually authenticated TLS over that stream, so the Anchor's
            dongle and relay only carry ciphertext. Hackathon feature.

    config WENDY_ESPNOW_LOG_BEACONS
        bool "Log every beacon's receive time (B lines)"
        depends on WENDY_ESPNOW
        default y
endmenu
```
